## config/west.yml
```yaml
manifest:
  remotes:
    - name: custom-zmk
      url-base: https://github.com/c-y-p-e
  projects:
    - name: zmk
      remote: custom-zmk
      revision: main
      import: app/west.yml
  self:
    path: config
```
